/* Bootloader symbol list */ 
define exported symbol BOOT_FLASH_RDP_VALID = 0x08000129;  
define exported symbol BOOT_FLASH_SetStatusReg = 0x0800040d;  
define exported symbol BOOT_FLASH_OTFMaskConfig = 0x08000451;  
define exported symbol BOOT_FLASH_Image1 = 0x08000483;  
define exported symbol IMAGE1$$Base = 0x10002001;  
define exported symbol RamStartTable = 0x10002001;  
define exported symbol RAM_IMG1_VALID_PATTEN = 0x10002019;  
define exported symbol boot_export_symbol = 0x10002021;  
define exported symbol BOOT_System_Init1 = 0x10002251;  
define exported symbol BOOT_System_Init2 = 0x10002263;  
define exported symbol BOOT_Swd_Off = 0x10002275;  
define exported symbol boot_ram_end = 0x1000246d;  
define exported symbol IMAGE1$$Limit = 0x10002471;  
